/ {
    chosen {
        zmk,rgb-strip = &backlight;
    };

    backlight: ws2812_strip {
        compatible = "worldsemi,ws2812-spi";
        label = "WS2812 Backlight";
        spi-max-frequency = <8000000>;
        chain-length = <30>;  // Set this to your actual LED count
        color-mapping = <LED_COLOR_MAPPING_GRB>;
    };
};
